## arch/arm/mach-msm/samsung/Kconfig
```kconfig
config MACH_ANCORA
	bool

menu "Samsung Board Selection"
source "arch/arm/mach-msm/samsung/Kconfig.board"
endmenu
```

## arch/arm/mach-msm/samsung/Kconfig.board
```kconfig
config MACH_ANCORA
	depends on ARCH_MSM7X30
	select APPSBOOT_3M_CONFIG
	bool "ANCORA"
	help
	  Support for the Samsung Ancora board.

config BOARD_REVISION
	hex "Select H/W Revision"
	depends on MACH_ANCORA
	default "0x00"

config HW_REV_USING_SMB328
	hex "Select H/W Revision using smb328"
	depends on CHARGER_SMB328A
	default "0x00"
```

## drivers/media/platform/msm_samsung/Kconfig
```kconfig
config MSM_CAMERA_V4L2
        bool "MSM Camera V4L2 Interface"
        depends on MSM_CAMERA
        default n
        ---help---
          This flag enables V4L2 interface of MSM
          camera driver. If enabled, application interacts
          with /dev/video0 through V4L2 APIs. Otherwise,
          native APIs are used through /dev/config0, /dev/frame0,
          and /dev/control0.

comment "Camera Sensor Selection"

config OEM_CAMERA
	bool "use oem camera feature"
	default y

config USE_QUP_I2C
	bool "use qup i2c feature"
	default y

config SENSOR_CE147
	bool "NEC ISP (BAYER 5M)"
	default n

config SENSOR_S5K4ECGX
	bool "LSI (BAYER 5M)"
	default n

config SENSOR_S5KA3DFX
	bool "LSI CIS (VGA)"
	default n  

config SENSOR_S5K5CCAF
	bool "Sensor s5k5cc 1/5 (3M/AF)"
	default n
	---help---
	  SAMSUNG 3M CMOS Sensor

config S5K3E2FX
	bool "Sensor s5k3e2fx (Samsung 5M)"
	depends on MSM_CAMERA && !ARCH_MSM8X60 && !MSM_CAMERA_V4L2
	default y
	---help---
	  Samsung 5M with Autofocus

config MSM_CAMERA_FLASH
	bool "Qualcomm MSM camera flash support"
	depends on MSM_CAMERA
	default y
	---help---
	  Enable support for LED flash for msm camera

config MSM_GEMINI
	tristate "Qualcomm MSM Gemini Jpeg Engine support"
	depends on MSM_CAMERA && (ARCH_MSM7X30 || ARCH_MSM8X60)
	default M
	---help---
	  Enable support for Gemini Jpeg Engine

config MSM_VPE
	tristate "Qualcomm MSM Video Pre-processing Engine support"
	depends on MSM_CAMERA && (ARCH_MSM7X30 || ARCH_MSM8X60)
	default y
	---help---
	  Enable support for Video Pre-processing Engine

config QUP_EXCLUSIVE_TO_CAMERA
	bool "QUP exclusive to camera"
	depends on MSM_CAMERA
	default y
	---help---
	  This flag enabled states that QUP
	  is exclusive to camera. In case this
	  is disabled, the lvs1 voltage is enabled
	  by QUP in the board file as QUP is used by
	  applications other than camera.
config SENSOR_SR030PC30
	bool "use VGS camera feature"
	default n

config SENSOR_SR030PC30_T679
	bool "use T679 VGS camera feature"
	default n	
config SENSOR_SR130PC10
	bool "use SGH-I847[Apache ATT] VGA camera feature"
	default n
```

## drivers/video/msm/Kconfig
```kconfig
source "drivers/video/msm/vidc/Kconfig"

config FB_MSM
	tristate "MSM Framebuffer support"
	depends on FB && ARCH_MSM
	select FB_BACKLIGHT if FB_MSM_BACKLIGHT
	select NEW_LEDS
	select LEDS_CLASS
	select FB_CFB_FILLRECT
	select FB_CFB_COPYAREA
	select FB_CFB_IMAGEBLIT
	---help---
	  Support for MSM Framebuffer.

if FB_MSM

config FB_MSM_BACKLIGHT
	bool "Support for backlight control"
	default y
	---help---
	  Say Y here if you want to control the backlight of your display.

config FB_MSM_LOGO
	bool "MSM Frame Buffer Logo"
	default n
	---help---
	  Show /initlogo.rle during boot.

config FB_MSM_LCDC_HW
	bool
	default n

config FB_MSM_TRIPLE_BUFFER
	bool "Support for triple frame buffer"
	default n

config FB_MSM_MDP_HW
	bool
	default n

choice
	prompt "MDP HW version"
	default FB_MSM_MDP22

config FB_MSM_MDP40
	select FB_MSM_LCDC_HW
	select FB_MSM_MDP_HW
	bool "MDP HW ver4.0"
	---help---
	  Support for MSM MDP HW revision 4.0
	  Say Y here if this is msm7x30 variant platform.

config FB_MSM_MDSS
	bool "MDSS HW"
	---help---
	The Mobile Display Sub System (MDSS) driver supports devices which
	contain MDSS hardware block.

	The MDSS driver implements frame buffer interface to provide access to
	the display hardware and provide a way for users to display graphics
	on connected display panels.

config FB_MSM_MDP_NONE
	bool "MDP HW None"
	---help---
	  Say Y here if this is mdm platform.

endchoice

config FB_MSM_MDDI
	bool
	default n

config FB_MSM_LCDC
	bool
	default n

config FB_MSM_OVERLAY
	depends on FB_MSM_MDP40
	bool "MDP4 overlay support"
	default n

config FB_MSM_DTV
	depends on FB_MSM_OVERLAY
	bool
	default n

config FB_MSM_TVOUT
	bool
	default n

config FB_MSM_LCDC_AUTO_DETECT
	bool
	select FB_MSM_LCDC
	default n

config FB_MSM_LCDC_PANEL
	bool
	select FB_MSM_LCDC
	default n

config FB_MSM_LCDC_SAMSUNG_ANCORA
	bool
	select FB_MSM_LCDC_PANEL
	default n

config FB_MSM_NO_MDP_PIPE_CTRL
	depends on FB_MSM_OVERLAY
	bool "Do not use mdp_pipe_ctrl"
	---help---
	  Saying 'Y' here obsoletes the mdp_pipe_ctrl function,
	  which was used to control mdp-related clocks. MDP4 vsync-driven
	  screen updates will use a different clock control mechanism if
	  this is selected.

config FB_MSM_OVERLAY0_WRITEBACK
	depends on FB_MSM_OVERLAY
        bool "MDP overlay0 write back mode enable"
	---help---
	  Support for MDP4 OVERLAY0 write back mode


config FB_MSM_OVERLAY1_WRITEBACK
        depends on FB_MSM_OVERLAY
        bool "MDP overlay1 write back mode enable"
        ---help---
          Support for MDP4 OVERLAY1 write back mode

config FB_MSM_WRITEBACK_MSM_PANEL
	depends on FB_MSM_OVERLAY
        bool "MDP overlay write back panel enable"
	---help---
	  Support for MDP4 OVERLAY write back mode
choice
	prompt "LCD Panel"
	default FB_MSM_MDDI_AUTO_DETECT

config FB_MSM_LCDC_SAMSUNG_ANCORA_PANEL
	depends on FB_MSM_LCDC_HW
	bool "LCDC SAMSUNG_ANCORA Panel"
	select FB_MSM_LCDC_SAMSUNG_ANCORA
	---help---
	  Support for LCDC SAMSUNG ANCORA panel

config FB_MSM_LCDC_PANEL_AUTO_DETECT
	bool "LCDC Panel Auto Detect"
	select FB_MSM_LCDC_AUTO_DETECT
	select FB_MSM_LCDC_SAMSUNG_WSVGA
	select FB_MSM_LCDC_AUO_WVGA
	select FB_MSM_LCDC_NT35582_WVGA
	select FB_MSM_LCDC_SAMSUNG_OLED_PT
	---help---
	  Support for LCDC panel auto detect

config FB_MSM_HDMI_AS_PRIMARY
	depends on FB_MSM_HDMI_COMMON
	bool "Use HDMI as primary panel"
	---help---
	Support for using HDMI as primary

config FB_MSM_PANEL_NONE
	bool "NONE"
	---help---
	  This will disable LCD panel
endchoice

config LGIT_VIDEO_WXGA_CABC
	bool "Content Adaptive Backlight Control on LGIT WXGA Panel"
	default y
	depends on FB_MSM_MIPI_LGIT_VIDEO_WXGA_PT_PANEL
	help
	  Enable CABC(Content Apaptive Backlight Control) on LGIT Panel
	  to reduce power consumption

choice
	prompt "Secondary LCD Panel"
	depends on  FB_MSM_MDP31
	default FB_MSM_SECONDARY_PANEL_NONE

config FB_MSM_SECONDARY_PANEL_NONE
	bool "NONE"
	---help---
	  No secondary panel
endchoice

config FB_MSM_HDMI_MSM_PANEL
	depends on FB_MSM_MDP40
	bool "MSM HDMI 1080p Panel"
	select FB_MSM_DTV
        select FB_MSM_EXT_INTERFACE_COMMON
	select FB_MSM_HDMI_COMMON
	select FB_MSM_HDMI_3D
	default n
	---help---
	  Support for 480p/720p/1080i/1080p output through MSM HDMI

choice
	depends on  (FB_MSM_MDP22 || FB_MSM_MDP31 || FB_MSM_MDP40)
	prompt "TVOut Region"
	default FB_MSM_TVOUT_NONE

choice
	prompt "Default framebuffer color depth"
	depends on FB_MSM_MDP40 || FB_MSM_MDP31 || FB_MSM_MDP303
	default FB_MSM_DEFAULT_DEPTH_RGBA8888

config FB_MSM_DEFAULT_DEPTH_RGB565
	bool "16 bits per pixel (RGB565)"

config FB_MSM_DEFAULT_DEPTH_ARGB8888
	bool "32 bits per pixel (ARGB8888)"

config FB_MSM_DEFAULT_DEPTH_RGBA8888
	bool "32 bits per pixel (RGBA8888)"

endchoice

endif
```
